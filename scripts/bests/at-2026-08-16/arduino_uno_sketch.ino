// ============================================================
// Self-balancing robot: R=1.4 / R=1.6 selectable 4-state LQR
//
// Base:
//   User's corrected 1-wheel + 6-stage input-delay observer code.
//
// Main policy of this version:
//   1) Preserve the experimentally best 4-state balance architecture.
//   2) Keep left/right synchronization kWheelSync = 1.20.
//   3) Remove the unsuccessful delta-u controller.
//   4) Compare only R=1.4 and R=1.6 by changing one enum line.
//   5) Keep the optional slow position-hold outer loop disabled by default.
//   6) Keep Serial logging at 20 Hz.
//
// IMPORTANT:
//   angleSpeedAverageA/B behavior is intentionally preserved from the
//   currently stable code. Do not "fix" this into conventional wheel-speed
//   feedback unless the lower loop is retuned from scratch.
//
// 2026-08-16 UPDATE:
//   All model-dependent constants below were regenerated by
//   design_best_R14_controller.py in this directory, for the plant:
//
//       T_pendulum = 0.75 s   (unchanged)
//       h_body     = 0.060 m  (was 0.080 m; does not affect the model)
//       dead time  = 0.110 s  (was 0.100 s, 6 stages)  <-- the real change
//
//   Only the dead time actually changed the model.  h_body and m_body
//   cancel out of both A_c coefficients, and a 0.45 s pendulum period
//   measured with a string turned out to be a two-DOF artifact (a rigid
//   body with h = 0.060 m cannot swing faster than 0.492 s), so the
//   nail-through-the-axle value of 0.75 s is kept.
//
//   Regenerated: A_d / B_d in the observer prediction, the observer gain L
//   in the correction step, and the LQR gains.  The observer gain is the
//   steady-state Kalman gain for Q_obs = I(10), R_obs = I(4), i.e. the same
//   recipe as the previous configuration.
//
//   The controller structure is unchanged.
//
// 2026-08-16 UPDATE 2 (after measuring the actuator):
//   1) The model now carries the measured motor gain km = 1.99.  The real
//      actuator is about twice as strong as every previous design assumed,
//      which is why R=1.0 diverged.  All gains below dropped accordingly:
//      K_theta went from -350 to -217.
//   2) Dead-zone compensation was added to the lower loop.  Below a duty of
//      about 0.25 (wheel A) / 0.35 (wheel B) the wheels do not move at all.
//
// 2026-08-16 UPDATE 3:
//   1) MsTimer2 IS GONE.  It owned Timer2, which drives the PWM on D3 and
//      D11, so analogWrite() on those two pins produced no PWM at all -
//      only the value 255 worked, because the core turns that into
//      digitalWrite(HIGH).  Measured effect: wheel B did not move for any
//      duty from 0.1 to 0.9.  Each motor could therefore only be driven in
//      ONE direction, which is what "only motor A moves" looks like from
//      the outside.  The 10 ms cycle now comes from micros(), so every
//      timer is left alone and all four motor pins really do PWM.
//   2) Q now weights the wheel angle: diag(10, 1, 1, 1, 0...) instead of
//      diag(10, 1, 0, 1, 0...).  K_wheel_angle is no longer forced to zero,
//      so the robot holds its position instead of wandering off.  The
//      closed-loop pole that used to sit exactly at 1.0 (the free wheel
//      position integrator) now sits at 0.9917.
//
//   Both changes alter the plant the gains were tuned against, so expect to
//   re-tune.  Fixing the PWM roughly doubles the usable actuation, and the
//   position feedback adds a slow mode that was not there before.
//
//   Still NOT applied: the same measurement puts tau_m at 0.44-0.82 s
//   rather than 0.070 s.  That came from wheels spinning free on a stand,
//   and folding it in would raise K_theta to about -647, so it waits for an
//   on-the-ground re-measurement.
// ============================================================

#define sign(x) ((x) < 0 ? -1 : ((x) > 0 ? 1 : 0))

#include <Wire.h>
#include <Adafruit_Sensor.h>
#include <Adafruit_BNO055.h>

// ------------------------------------------------------------
// Global timing
// ------------------------------------------------------------
unsigned long previousTime = 0;

// The 10 ms cycle is scheduled from micros(), NOT from MsTimer2.
// MsTimer2 owns Timer2, which drives the PWM on D3 and D11, and that broke
// one direction of each motor outright (see the 2026-08-16 UPDATE 3 note).
const unsigned long CONTROL_PERIOD_US = 10000UL;
const float CONTROL_DT_SEC = 0.010f;

unsigned long nextControlUs = 0;

// ------------------------------------------------------------
// BNO055
// ------------------------------------------------------------
Adafruit_BNO055 bno = Adafruit_BNO055(55);

float bodyAngleOffset = 0.0f;
float bodyAngleInRad = 0.0f;
float bodyAngleSpeedInRadPerSec = 0.0f;

// ------------------------------------------------------------
// Motor pins
// ------------------------------------------------------------
const int MOTOR_A_PIN_IN1 = 3;
const int MOTOR_A_PIN_IN2 = 9;
const int MOTOR_B_PIN_IN1 = 10;
const int MOTOR_B_PIN_IN2 = 11;

// ------------------------------------------------------------
// Encoder pins
// ------------------------------------------------------------
const int ROTARY_ENCODER_A_PIN_1 = 4;
const int ROTARY_ENCODER_A_PIN_2 = 2;
const int ROTARY_ENCODER_B_PIN_1 = 8;
const int ROTARY_ENCODER_B_PIN_2 = 7;

// ------------------------------------------------------------
// Physical/model parameters
// ------------------------------------------------------------
float T_sample = 0.010f;

float r_wheel = 2.7f * 0.01f;
float g = 9.8f;
float m_body = 350.0f * 0.001f;
float h_body = 6.0f * 0.01f;
float m_wheel = 10.0f * 0.001f;

float T_pendulum = 0.75f;
float I_eff =
    pow(T_pendulum, 2) * m_body * g * h_body
    / (4.0f * pow(PI, 2));

float tau_motor = 0.07f;

// ------------------------------------------------------------
// Balance-controller selection
// ------------------------------------------------------------
// The real robot was much more stable with the ordinary 4-state LQR
// than with the augmented delta-u controller, so this version removes
// the delta-u controller completely.
//
// Two input weights are retained for a clean A/B comparison.
// Change ONE line below to switch between them.
//
// IMPORTANT: unlike earlier revisions of this sketch, the mode names now
// match the input weight R the constants were actually designed with.
// The old MODE_R14_4STATE slot held the R=1.0 solution, which contributed
// to a confusing runaway during the 2026-08-16 tests.
//
//   MODE_R18_4STATE : current default; R=1.8 is experimentally stable
//   MODE_R30_4STATE : next test, about 4% softer than R=1.8
//
// 2026-08-16 bench results with this plant model:
//   R=1.0            -> motors diverged, fell immediately
//   R=1.6 and R=1.8  -> stable, some "gikogiko" chattering remains
//
// NOTE: raising R has a hard floor.  Even R -> infinity only reaches
// 0.827x the R=1.0 gain, and the K_theta_dot / K_theta ratio stays at
// 0.1194 for every R.  If more margin is needed, the motor gain km in the
// design model is the effective knob, not R.
enum BalanceControllerMode : uint8_t {
  MODE_R18_4STATE = 0,
  MODE_R30_4STATE = 1
};

// Start from the current best result.
// Change only this line to MODE_R30_4STATE for the next experiment.
const BalanceControllerMode BALANCE_CONTROLLER_MODE = MODE_R18_4STATE;

// ------------------------------------------------------------
// R = 1.8 discrete LQR   <-- DEFAULT
// ------------------------------------------------------------
// Design basis (2026-08-16 model):
//   T_pendulum = 0.75 s, h_body = 0.060 m, dead time = 0.110 s
//   km = 1.99 (measured 2026-08-16)
//   Q = diag(10, 1, 1, 1, 0, 0, 0, 0, 0, 0)   <-- wheel angle now weighted
//   R = 1.8
//
// Full gain calculated from the embedded A_d/B_d:
//   [-237.705891, -28.381120, -0.663467, -3.484149,
//      0.906499,   0.785472,   0.676866,  0.577751,
//      0.486363,   0.403040]
//
// As in the successful real-robot tests, only the first four gains
// are applied directly to the control command.  These constants are the
// genuine R=1.8 solution; name and contents agree.
const float K_R18_THETA = -237.705891f;
const float K_R18_THETA_DOT = -28.381120f;
const float K_R18_WHEEL_ANGLE = -0.663467f;  // position hold, see UPDATE 3
const float K_R18_WHEEL_SPEED = -3.484149f;

// ------------------------------------------------------------
// R = 3.0 discrete LQR
// ------------------------------------------------------------
// Same Q and same plant model; only the input penalty R is raised
// from 1.8 to 3.0, giving roughly 4% softer gains.
//
// Full gain:
//   [-214.138525, -25.565794, -0.518734, -3.138217,
//      0.816066,   0.706955,   0.610091,  0.522990,
//      0.443838,   0.372456]
//
// Again, only the first four gains are used in the successful
// 4-state feedback architecture.
const float K_R30_THETA = -214.138525f;
const float K_R30_THETA_DOT = -25.565794f;
const float K_R30_WHEEL_ANGLE = -0.518734f;  // position hold, see UPDATE 3
const float K_R30_WHEEL_SPEED = -3.138217f;

// Previous command is used ONLY for diagnostics (dU logging).
// It does not affect the controller.
float previousCommandForLog = 0.0f;

// Original delay-state gain names kept for compatibility/debug reference.
// The z states remain active inside the observer/model, but are not directly
// fed back into u_WheelAngleSpeed.
float gainZ1 = 0.906499f;
float gainZ2 = 0.785472f;
float gainZ3 = 0.676866f;
float gainZ4 = 0.577751f;
float gainZ5 = 0.486363f;
float gainZ6 = 0.403040f;

// ------------------------------------------------------------
// Dead-zone compensation
// ------------------------------------------------------------
// Measured on 2026-08-16 (scripts/motor-calibration/km-identification):
// with the wheels free, wheel A does not turn at all below a duty of about
// 0.25 and wheel B below about 0.35.  The balance loop puts out roughly
// 0.025 * u, so anything under about 2 degrees of tilt commands a duty that
// moves nothing.  The controller then has to wait for the error to grow
// before the wheels respond at all, which is the most likely source of the
// "gikogiko" chattering.
//
// The compensation adds the breakaway duty back on, so that a small command
// produces a small but non-zero motion:
//
//     duty = sign(u) * (DEADZONE * FRACTION + |u|)
//
// FRACTION deliberately under-compensates.  Inverting a dead zone exactly
// puts a jump of DEADZONE at every zero crossing, and over-compensating
// turns that jump into its own limit cycle.
//
// Set ENABLE_DEADZONE_COMPENSATION to false for a clean A/B against the
// previous behavior.
const bool ENABLE_DEADZONE_COMPENSATION = true;

const float DEADZONE_A = 0.25f;
const float DEADZONE_B = 0.35f;
const float DEADZONE_FRACTION = 0.8f;

// Commands below this are treated as zero, so that sensor noise around the
// upright point cannot rattle the output between +DEADZONE and -DEADZONE.
const float DEADZONE_MIN_COMMAND = 0.002f;

float compensateDeadZone(float duty, float deadzone) {
  if (!ENABLE_DEADZONE_COMPENSATION) {
    return duty;
  }

  if (abs(duty) < DEADZONE_MIN_COMMAND) {
    return 0.0f;
  }

  const float offset = deadzone * DEADZONE_FRACTION;
  return duty + (duty > 0.0f ? offset : -offset);
}

// ------------------------------------------------------------
// Left/right synchronization
// ------------------------------------------------------------
// Only this gain is intentionally kept stronger than the old baseline.
float kWheelSync = 1.20f;

// ------------------------------------------------------------
// Optional slow position-hold outer loop
// ------------------------------------------------------------
// Keep this false.  Since UPDATE 3 the LQR itself holds position through
// K_wheel_angle, so this slow outer loop would be a second, redundant
// position controller fighting the first one.  It is kept only as a record
// of an earlier approach.
const bool ENABLE_SLOW_POSITION_HOLD = false;

// Update the slow outer loop at 10 Hz while the balance loop remains 100 Hz.
const uint8_t POSITION_LOOP_DIVIDER = 10;

// [rad body reference] / [rad wheel-position error]
float K_POSITION_TO_LEAN = 0.0010f;

// Limit the slow tilt correction to +/-0.5 deg initially.
const float MAX_POSITION_TRIM_RAD = 0.5f * PI / 180.0f;

// Low-pass filtering of the slow position trim.
const float POSITION_TRIM_ALPHA = 0.90f;

float wheelPositionReference = 0.0f;
float bodyAngleTrimFromPosition = 0.0f;
uint8_t positionLoopCounter = 0;

// ------------------------------------------------------------
// Delay-state estimates
// ------------------------------------------------------------
float z1Estimated = 0.0f;
float z2Estimated = 0.0f;
float z3Estimated = 0.0f;
float z4Estimated = 0.0f;
float z5Estimated = 0.0f;
float z6Estimated = 0.0f;

float z1EstimatedPrev = 0.0f;
float z2EstimatedPrev = 0.0f;
float z3EstimatedPrev = 0.0f;
float z4EstimatedPrev = 0.0f;
float z5EstimatedPrev = 0.0f;
float z6EstimatedPrev = 0.0f;

// ------------------------------------------------------------
// Encoder sampling variables
// ------------------------------------------------------------
float angleA = 0.0f;
float angleB = 0.0f;

float anglePrevA = 0.0f;
float anglePrevB = 0.0f;

float angleSpeedA = 0.0f;
float angleSpeedB = 0.0f;

float angleSpeedAverageA = 0.0f;
float angleSpeedAverageB = 0.0f;

float timeNow1 = 0.0f;
float timePrev1 = 0.0f;

const float angleSensorTimeDeltaSec = 0.0001f;
const float alpha = 0.8f;

// ------------------------------------------------------------
// Observer state
// ------------------------------------------------------------
float bodyAngleInRadEstimated = 0.0f;
float bodyAngleSpeedInRadPerSecEstimated = 0.0f;
float wheelAngleInRadEstimated = 0.0f;
float wheelAngleSpeedInRadPerSecEstimated = 0.0f;

float bodyAngleInRadEstimatedPrev = 0.0f;
float bodyAngleSpeedInRadPerSecEstimatedPrev = 0.0f;
float wheelAngleInRadEstimatedPrev = 0.0f;
float wheelAngleSpeedInRadPerSecEstimatedPrev = 0.0f;

float wheelAngleInRad = 0.0f;
float wheelAngleSpeedInRadPerSec = 0.0f;

float u_WheelAngleSpeed = 0.0f;

// ------------------------------------------------------------
// Lower motor loop
// ------------------------------------------------------------
// Preserve the asymmetry that was present in the stable code.
float kpA = 0.025f;
float kpB = 0.030f;
float kiA = 0.040f;
float kiB = 0.050f;

float eAI = 0.0f;
float eBI = 0.0f;

// ------------------------------------------------------------
// Diagnostics / safety
// ------------------------------------------------------------
const uint8_t LOG_DIVIDER = 5;   // 100 Hz / 5 = 20 Hz
uint8_t logCounter = 0;

const float FALL_ANGLE_LIMIT_RAD = 35.0f * PI / 180.0f;

// ============================================================
// Body angle sampler
// ============================================================
class BodyAngleSampler {
private:
  float current_value;
  float prev_value;

public:
  BodyAngleSampler() {
    current_value = 0.0f;
    prev_value = 0.0f;
  }

  float sampleInRad() {
    sensors_event_t orientation_event;
    bno.getEvent(&orientation_event, Adafruit_BNO055::VECTOR_EULER);

    prev_value = current_value;

    // Preserve the same behavior around the problematic Euler region.
    if (abs(orientation_event.orientation.z) < 20.0f) {
      return (prev_value - bodyAngleOffset) * PI / 180.0f;
    }

    current_value = orientation_event.orientation.z;
    return (current_value - bodyAngleOffset) * PI / 180.0f;
  }
};

// ============================================================
// Encoder A
// ============================================================
class WheelAngleSamplerA {
private:
  int pin_a;
  int pin_b;
  int pin_a_prev;
  int pin_b_prev;
  long cnt_encoder;

public:
  WheelAngleSamplerA() {
    cnt_encoder = 0;

    pinMode(ROTARY_ENCODER_A_PIN_1, INPUT_PULLUP);
    pinMode(ROTARY_ENCODER_A_PIN_2, INPUT_PULLUP);

    pin_a = digitalRead(ROTARY_ENCODER_A_PIN_1);
    pin_b = digitalRead(ROTARY_ENCODER_A_PIN_2);

    pin_a_prev = pin_a;
    pin_b_prev = pin_b;
  }

  float sampleInRad() {
    pin_a = digitalRead(ROTARY_ENCODER_A_PIN_1);
    pin_b = digitalRead(ROTARY_ENCODER_A_PIN_2);

    if (pin_a != pin_a_prev) {
      if (pin_a == pin_b) {
        cnt_encoder += 1;
      } else {
        cnt_encoder -= 1;
      }
    }

    if (pin_b != pin_b_prev) {
      if (pin_a == pin_b) {
        cnt_encoder -= 1;
      } else {
        cnt_encoder += 1;
      }
    }

    pin_a_prev = pin_a;
    pin_b_prev = pin_b;

    return float(cnt_encoder)
           * (20.0f / 14.0f)
           * (360.0f / 48.0f)
           / 360.0f
           * 2.0f * PI;
  }
};

// ============================================================
// Encoder B
// ============================================================
class WheelAngleSamplerB {
private:
  int pin_a;
  int pin_b;
  int pin_a_prev;
  int pin_b_prev;
  long cnt_encoder;

public:
  WheelAngleSamplerB() {
    cnt_encoder = 0;

    pinMode(ROTARY_ENCODER_B_PIN_1, INPUT_PULLUP);
    pinMode(ROTARY_ENCODER_B_PIN_2, INPUT_PULLUP);

    pin_a = digitalRead(ROTARY_ENCODER_B_PIN_1);
    pin_b = digitalRead(ROTARY_ENCODER_B_PIN_2);

    pin_a_prev = pin_a;
    pin_b_prev = pin_b;
  }

  float sampleInRad() {
    pin_a = digitalRead(ROTARY_ENCODER_B_PIN_1);
    pin_b = digitalRead(ROTARY_ENCODER_B_PIN_2);

    if (pin_a != pin_a_prev) {
      if (pin_a == pin_b) {
        cnt_encoder -= 1;
      } else {
        cnt_encoder += 1;
      }
    }

    if (pin_b != pin_b_prev) {
      if (pin_a == pin_b) {
        cnt_encoder += 1;
      } else {
        cnt_encoder -= 1;
      }
    }

    pin_a_prev = pin_a;
    pin_b_prev = pin_b;

    return float(cnt_encoder)
           * (20.0f / 12.0f)
           * (360.0f / 48.0f)
           / 360.0f
           * 2.0f * PI;
  }
};

// ============================================================
// BNO gyro
// ============================================================
float getBodyAngleSpeedInRadPerSec() {
  sensors_event_t gyro_event;
  bno.getEvent(&gyro_event, Adafruit_BNO055::VECTOR_GYROSCOPE);
  return -gyro_event.gyro.x;
}

// ============================================================
// Motor output
// ============================================================
void setLeftDutyCycle(float pwm_value) {
  pwm_value = constrain(pwm_value, -1.0f, 1.0f);

  if (sign(pwm_value) == 0) {
    analogWrite(MOTOR_A_PIN_IN1, 255);
    analogWrite(MOTOR_A_PIN_IN2, 255);
    return;
  }

  if (sign(pwm_value) > 0) {
    analogWrite(MOTOR_A_PIN_IN1, 0);
    analogWrite(MOTOR_A_PIN_IN2, int(abs(pwm_value) * 255.0f));
  } else {
    analogWrite(MOTOR_A_PIN_IN2, 0);
    analogWrite(MOTOR_A_PIN_IN1, int(abs(pwm_value) * 255.0f));
  }
}

void setRightDutyCycle(float pwm_value) {
  pwm_value = constrain(pwm_value, -1.0f, 1.0f);

  if (sign(pwm_value) == 0) {
    analogWrite(MOTOR_B_PIN_IN1, 255);
    analogWrite(MOTOR_B_PIN_IN2, 255);
    return;
  }

  if (sign(pwm_value) > 0) {
    analogWrite(MOTOR_B_PIN_IN1, 0);
    analogWrite(MOTOR_B_PIN_IN2, int(abs(pwm_value) * 255.0f));
  } else {
    analogWrite(MOTOR_B_PIN_IN2, 0);
    analogWrite(MOTOR_B_PIN_IN1, int(abs(pwm_value) * 255.0f));
  }
}

void stopMotors() {
  setLeftDutyCycle(0.0f);
  setRightDutyCycle(0.0f);
}

// ============================================================
// Objects
// ============================================================
BodyAngleSampler bodyAngleSampler;
WheelAngleSamplerA wheelAngleSamplerA;
WheelAngleSamplerB wheelAngleSamplerB;

// ============================================================
// Setup
// ============================================================
void setup() {
  Serial.begin(115200);

  if (!bno.begin()) {
    Serial.println("BNO055 initialization failed.");

    while (1) {
      stopMotors();
    }
  }

  bno.setExtCrystalUse(true);
  bno.setMode(adafruit_bno055_opmode_t::OPERATION_MODE_NDOF);

  pinMode(MOTOR_A_PIN_IN1, OUTPUT);
  pinMode(MOTOR_A_PIN_IN2, OUTPUT);
  pinMode(MOTOR_B_PIN_IN1, OUTPUT);
  pinMode(MOTOR_B_PIN_IN2, OUTPUT);

  pinMode(ROTARY_ENCODER_A_PIN_1, INPUT_PULLUP);
  pinMode(ROTARY_ENCODER_A_PIN_2, INPUT_PULLUP);
  pinMode(ROTARY_ENCODER_B_PIN_1, INPUT_PULLUP);
  pinMode(ROTARY_ENCODER_B_PIN_2, INPUT_PULLUP);

  stopMotors();

  // ----------------------------------------------------------
  // Body angle offset calibration
  // ----------------------------------------------------------
  int angleCalibrationCnt = 0;

  for (int i = 0; i < 300; i++) {
    sensors_event_t orientation_event;
    bno.getEvent(&orientation_event, Adafruit_BNO055::VECTOR_EULER);

    if (abs(orientation_event.orientation.z) > 20.0f) {
      bodyAngleOffset += orientation_event.orientation.z;
      angleCalibrationCnt++;
    }

    delay(10);
  }

  if (angleCalibrationCnt > 0) {
    bodyAngleOffset /= float(angleCalibrationCnt);
  } else {
    bodyAngleOffset = 0.0f;
  }

  // Encoders start from zero in these sampler classes.
  wheelPositionReference = 0.0f;

  previousTime = micros();
  nextControlUs = micros();
}

// ============================================================
// Main loop
// ============================================================
void loop() {
  // ----------------------------------------------------------
  // Fast encoder polling
  // ----------------------------------------------------------
  timeNow1 = micros() * 0.001f * 0.001f;

  if ((timeNow1 - timePrev1) > angleSensorTimeDeltaSec) {
    angleA = wheelAngleSamplerA.sampleInRad();
    angleB = wheelAngleSamplerB.sampleInRad();

    float dt = timeNow1 - timePrev1;

    if (dt > 0.0f) {
      angleSpeedA =
          alpha * angleSpeedA
          + (1.0f - alpha) * (angleA - anglePrevA) / dt;

      angleSpeedB =
          alpha * angleSpeedB
          + (1.0f - alpha) * (angleB - anglePrevB) / dt;
    }

    // --------------------------------------------------------
    // IMPORTANT:
    // Preserve the effective behavior of the current stable code.
    // --------------------------------------------------------
    angleSpeedAverageA +=
        angleSpeedAverageA
        / (CONTROL_DT_SEC / angleSensorTimeDeltaSec);

    angleSpeedAverageB +=
        angleSpeedAverageB
        / (CONTROL_DT_SEC / angleSensorTimeDeltaSec);

    anglePrevA = angleA;
    anglePrevB = angleB;
    timePrev1 = timeNow1;
  }

  // ----------------------------------------------------------
  // Control-cycle timing (no hardware timer: see the header note)
  // ----------------------------------------------------------
  if ((long)(micros() - nextControlUs) < 0) {
    return;
  }
  nextControlUs += CONTROL_PERIOD_US;

  unsigned long currentTime = micros();
  unsigned long elapsedTime = currentTime - previousTime;
  previousTime = currentTime;

  // ----------------------------------------------------------
  // Sensors
  // ----------------------------------------------------------
  bodyAngleInRad = bodyAngleSampler.sampleInRad();
  bodyAngleSpeedInRadPerSec = getBodyAngleSpeedInRadPerSec();

  wheelAngleInRad = (angleA + angleB) * 0.5f;
  wheelAngleSpeedInRadPerSec =
      (angleSpeedAverageA + angleSpeedAverageB) * 0.5f;

  // ----------------------------------------------------------
  // Safety cutoff
  // ----------------------------------------------------------
  if (abs(bodyAngleInRad) > FALL_ANGLE_LIMIT_RAD) {
    stopMotors();

    eAI = 0.0f;
    eBI = 0.0f;
    previousCommandForLog = 0.0f;
    bodyAngleTrimFromPosition = 0.0f;

    angleSpeedAverageA = 0.0f;
    angleSpeedAverageB = 0.0f;

    return;
  }

  // ==========================================================
  // Observer prediction
  // ==========================================================
  bodyAngleInRadEstimated = 0.0f;
  bodyAngleSpeedInRadPerSecEstimated = 0.0f;
  wheelAngleInRadEstimated = 0.0f;
  wheelAngleSpeedInRadPerSecEstimated = 0.0f;

  z1Estimated = 0.0f;
  z2Estimated = 0.0f;
  z3Estimated = 0.0f;
  z4Estimated = 0.0f;
  z5Estimated = 0.0f;
  z6Estimated = 0.0f;

  bodyAngleInRadEstimated +=
      1.003511f * bodyAngleInRadEstimatedPrev
      + 0.010012f * bodyAngleSpeedInRadPerSecEstimatedPrev
      + 0.000132f * wheelAngleSpeedInRadPerSecEstimatedPrev
      - 0.000220f * z1EstimatedPrev
      - 0.000037f * z2EstimatedPrev
      - 0.000005f * z3EstimatedPrev
      - 0.000001f * z4EstimatedPrev;

  bodyAngleSpeedInRadPerSecEstimated +=
      0.702660f * bodyAngleInRadEstimatedPrev
      + 1.003511f * bodyAngleSpeedInRadPerSecEstimatedPrev
      + 0.025772f * wheelAngleSpeedInRadPerSecEstimatedPrev
      - 0.039282f * z1EstimatedPrev
      - 0.009989f * z2EstimatedPrev
      - 0.001753f * z3EstimatedPrev
      - 0.000234f * z4EstimatedPrev
      - 0.000025f * z5EstimatedPrev
      - 0.000002f * z6EstimatedPrev;

  wheelAngleInRadEstimated +=
      1.000000f * wheelAngleInRadEstimatedPrev
      + 0.009319f * wheelAngleSpeedInRadPerSecEstimatedPrev
      + 0.001137f * z1EstimatedPrev
      + 0.000191f * z2EstimatedPrev
      + 0.000025f * z3EstimatedPrev
      + 0.000003f * z4EstimatedPrev;

  wheelAngleSpeedInRadPerSecEstimated +=
      0.866878f * wheelAngleSpeedInRadPerSecEstimatedPrev
      + 0.202871f * z1EstimatedPrev
      + 0.051626f * z2EstimatedPrev
      + 0.009063f * z3EstimatedPrev
      + 0.001210f * z4EstimatedPrev
      + 0.000130f * z5EstimatedPrev
      + 0.000012f * z6EstimatedPrev;

  // Corrected z1 transition
  z1Estimated +=
      0.579578f * z1EstimatedPrev
      + 0.316134f * z2EstimatedPrev
      + 0.086218f * z3EstimatedPrev
      + 0.015676f * z4EstimatedPrev
      + 0.002138f * z5EstimatedPrev
      + 0.000233f * z6EstimatedPrev;

  z2Estimated +=
      0.579578f * z2EstimatedPrev
      + 0.316134f * z3EstimatedPrev
      + 0.086218f * z4EstimatedPrev
      + 0.015676f * z5EstimatedPrev
      + 0.002138f * z6EstimatedPrev;

  z3Estimated +=
      0.579578f * z3EstimatedPrev
      + 0.316134f * z4EstimatedPrev
      + 0.086218f * z5EstimatedPrev
      + 0.015676f * z6EstimatedPrev;

  z4Estimated +=
      0.579578f * z4EstimatedPrev
      + 0.316134f * z5EstimatedPrev
      + 0.086218f * z6EstimatedPrev;

  z5Estimated +=
      0.579578f * z5EstimatedPrev
      + 0.316134f * z6EstimatedPrev;

  z6Estimated +=
      0.579578f * z6EstimatedPrev;

  // Input contribution
  wheelAngleSpeedInRadPerSecEstimated +=
      0.000001f * u_WheelAngleSpeed;

  z1Estimated += 0.000023f * u_WheelAngleSpeed;
  z2Estimated += 0.000256f * u_WheelAngleSpeed;
  z3Estimated += 0.002394f * u_WheelAngleSpeed;
  z4Estimated += 0.018070f * u_WheelAngleSpeed;
  z5Estimated += 0.104288f * u_WheelAngleSpeed;
  z6Estimated += 0.420422f * u_WheelAngleSpeed;

  // ==========================================================
  // Observer correction
  // ==========================================================
  float e1 =
      bodyAngleInRad
      - bodyAngleInRadEstimatedPrev;

  float e2 =
      bodyAngleSpeedInRadPerSec
      - bodyAngleSpeedInRadPerSecEstimatedPrev;

  float e3 =
      wheelAngleInRad
      - wheelAngleInRadEstimatedPrev;

  float e4 =
      wheelAngleSpeedInRadPerSec
      - wheelAngleSpeedInRadPerSecEstimatedPrev;

  bodyAngleInRadEstimated +=
      0.604646f * e1
      + 0.064224f * e2
      + 0.000005f * e3
      + 0.001204f * e4;

  bodyAngleSpeedInRadPerSecEstimated +=
      0.064224f * e1
      + 0.663255f * e2
      - 0.000015f * e3
      - 0.004075f * e4;

  wheelAngleInRadEstimated +=
      0.000005f * e1
      - 0.000015f * e2
      + 0.618045f * e3
      + 0.001120f * e4;

  wheelAngleSpeedInRadPerSecEstimated +=
      0.001204f * e1
      - 0.004075f * e2
      + 0.001120f * e3
      + 0.632616f * e4;

  z1Estimated +=
      0.009330f * e1
      - 0.036770f * e2
      + 0.001357f * e3
      + 0.246167f * e4;

  z2Estimated +=
      0.005832f * e1
      - 0.023385f * e2
      + 0.000768f * e3
      + 0.155419f * e4;

  z3Estimated +=
      0.003148f * e1
      - 0.012870f * e2
      + 0.000397f * e3
      + 0.084902f * e4;

  z4Estimated +=
      0.001406f * e1
      - 0.005877f * e2
      + 0.000169f * e3
      + 0.038450f * e4;

  z5Estimated +=
      0.000466f * e1
      - 0.001996f * e2
      + 0.000053f * e3
      + 0.012943f * e4;

  z6Estimated +=
      0.000087f * e1
      - 0.000381f * e2
      + 0.000009f * e3
      + 0.002451f * e4;

  wheelAngleSpeedInRadPerSecEstimated =
      constrain(
          wheelAngleSpeedInRadPerSecEstimated,
          -20.0f * 2.0f * PI,
           20.0f * 2.0f * PI);

  // Save observer states
  bodyAngleInRadEstimatedPrev =
      bodyAngleInRadEstimated;

  bodyAngleSpeedInRadPerSecEstimatedPrev =
      bodyAngleSpeedInRadPerSecEstimated;

  wheelAngleInRadEstimatedPrev =
      wheelAngleInRadEstimated;

  wheelAngleSpeedInRadPerSecEstimatedPrev =
      wheelAngleSpeedInRadPerSecEstimated;

  z1EstimatedPrev = z1Estimated;
  z2EstimatedPrev = z2Estimated;
  z3EstimatedPrev = z3Estimated;
  z4EstimatedPrev = z4Estimated;
  z5EstimatedPrev = z5Estimated;
  z6EstimatedPrev = z6Estimated;

  // ==========================================================
  // Optional slow position-hold outer loop
  // ==========================================================
  if (ENABLE_SLOW_POSITION_HOLD) {
    positionLoopCounter++;

    if (positionLoopCounter >= POSITION_LOOP_DIVIDER) {
      positionLoopCounter = 0;

      float positionError =
          wheelAngleInRad - wheelPositionReference;

      float targetTrim =
          -K_POSITION_TO_LEAN * positionError;

      targetTrim =
          constrain(
              targetTrim,
              -MAX_POSITION_TRIM_RAD,
               MAX_POSITION_TRIM_RAD);

      bodyAngleTrimFromPosition =
          POSITION_TRIM_ALPHA * bodyAngleTrimFromPosition
          + (1.0f - POSITION_TRIM_ALPHA) * targetTrim;
    }
  } else {
    bodyAngleTrimFromPosition = 0.0f;
  }

  // ==========================================================
  // Balance controller
  // ==========================================================
  // The optional slow position loop changes only the body-angle reference.
  float bodyAngleForControl =
      bodyAngleInRadEstimated
      - bodyAngleTrimFromPosition;

  float newCommand = 0.0f;

  if (BALANCE_CONTROLLER_MODE == MODE_R18_4STATE) {
    // --------------------------------------------------------
    // R = 1.8 : current default (experimentally stable)
    // --------------------------------------------------------
    newCommand =
        -K_R18_THETA * bodyAngleForControl
        -K_R18_THETA_DOT * bodyAngleSpeedInRadPerSecEstimated
        -K_R18_WHEEL_ANGLE * wheelAngleInRadEstimated
        -K_R18_WHEEL_SPEED * wheelAngleSpeedInRadPerSecEstimated;

  } else {
    // --------------------------------------------------------
    // R = 3.0 : stronger input-energy penalty, softer gains
    // --------------------------------------------------------
    newCommand =
        -K_R30_THETA * bodyAngleForControl
        -K_R30_THETA_DOT * bodyAngleSpeedInRadPerSecEstimated
        -K_R30_WHEEL_ANGLE * wheelAngleInRadEstimated
        -K_R30_WHEEL_SPEED * wheelAngleSpeedInRadPerSecEstimated;
  }

  // Diagnostic only: how much the requested common command changed
  // from the preceding control cycle.
  float deltaUForLog =
      newCommand - previousCommandForLog;

  u_WheelAngleSpeed = newCommand;
  previousCommandForLog = newCommand;

  // ==========================================================
  // Left/right synchronization
  // ==========================================================
  float wheelDiff = angleB - angleA;

  float eA =
      u_WheelAngleSpeed
      - angleSpeedAverageA
      + kWheelSync * wheelDiff;

  float eB =
      u_WheelAngleSpeed
      - angleSpeedAverageB
      - kWheelSync * wheelDiff;

  // Preserve the leaky PI behavior
  eAI =
      eA * CONTROL_DT_SEC
      + eAI * 0.99f;

  eBI =
      eB * CONTROL_DT_SEC
      + eBI * 0.99f;

  float uA =
      kpA * eA
      + kiA * eAI;

  float uB =
      kpB * eB
      + kiB * eBI;

  uA = compensateDeadZone(uA, DEADZONE_A);
  uB = compensateDeadZone(uB, DEADZONE_B);

  uA = constrain(uA, -1.0f, 1.0f);
  uB = constrain(uB, -1.0f, 1.0f);

  setLeftDutyCycle(uA);
  setRightDutyCycle(uB);

  // ==========================================================
  // 20 Hz diagnostics
  // ==========================================================
  logCounter++;

  if (logCounter >= LOG_DIVIDER) {
    logCounter = 0;

    Serial.print("dt_us:");
    Serial.print(elapsedTime);

    Serial.print(",angle:");
    Serial.print(bodyAngleInRad, 6);

    Serial.print(",gyro:");
    Serial.print(bodyAngleSpeedInRadPerSec, 6);

    Serial.print(",wheelPos:");
    Serial.print(wheelAngleInRad, 6);

    Serial.print(",wheelPosEst:");
    Serial.print(wheelAngleInRadEstimated, 6);

    Serial.print(",wheelSpeedEst:");
    Serial.print(wheelAngleSpeedInRadPerSecEstimated, 6);

    Serial.print(",wheelDiff:");
    Serial.print(wheelDiff, 6);

    Serial.print(",posTrim:");
    Serial.print(bodyAngleTrimFromPosition, 6);

    Serial.print(",mode:");
    Serial.print((int)BALANCE_CONTROLLER_MODE);

    Serial.print(",uPrev:");
    Serial.print(previousCommandForLog, 6);

    Serial.print(",dU:");
    Serial.print(deltaUForLog, 6);

    Serial.print(",uRef:");
    Serial.print(u_WheelAngleSpeed, 6);

    Serial.print(",pwmA:");
    Serial.print(uA, 6);

    Serial.print(",pwmB:");
    Serial.print(uB, 6);

    Serial.println();
  }

  // ----------------------------------------------------------
  // End of control cycle
  // ----------------------------------------------------------
  angleSpeedAverageA = 0.0f;
  angleSpeedAverageB = 0.0f;
}
